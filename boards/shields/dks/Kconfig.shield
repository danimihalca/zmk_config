## boards/shields/dks/Kconfig.shield
```kconfig
# Copyright (c) 2020 Pete Johanson
# SPDX-License-Identifier: MIT

config SHIELD_dks_LEFT
    def_bool $(shields_list_contains,dks_left)

config SHIELD_dks_RIGHT
    def_bool $(shields_list_contains,dks_right)
```
